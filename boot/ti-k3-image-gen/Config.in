## boot/ti-k3-image-gen/Config.in
```kconfig
config BR2_TARGET_TI_K3_IMAGE_GEN
	bool "ti-k3-image-gen"
	select BR2_TARGET_TI_K3_R5_LOADER
	help
	  Use TI's k3-image-gen to build a separate bare metal
	  boot binary from a separate SPL that is running on
	  the R5 core. Currently supports version 08.06.00.007
	  as default.

	  https://git.ti.com/cgit/k3-image-gen/k3-image-gen/

if BR2_TARGET_TI_K3_IMAGE_GEN
choice
	prompt "SoC firmware type for image gen"
	default BR2_TARGET_TI_K3_IMAGE_GEN_FW_TYPE_TIFS

config BR2_TARGET_TI_K3_IMAGE_GEN_FW_TYPE_TIFS
	bool "Firmware type TIFS"
	help
	  Use firmware type TIFS for SoCs like AM62x and
	  AM62Ax.

config BR2_TARGET_TI_K3_IMAGE_GEN_FW_TYPE_TISCI
	bool "Firmware type TISCI"
	help
	  Use firmware type TISCI for SoCs like AM64x and
	  AM65x.

endchoice

config BR2_TARGET_TI_K3_IMAGE_GEN_SOC
	string "SoC type for image gen"
	help
	  The target SoC option for image gen.
	  For example, "am64x" for AM64x boards.

config BR2_TARGET_TI_K3_IMAGE_GEN_SOC_TYPE
	string "SoC security type for image gen"
	help
	  The security type option for image gen.
	  Valid options are "gp" for Gerneral Purpose devices,
	  "hs-fs" for High Security - Field Securable devices, or
	  "hs" for High Security - Security Enforcing devices.

config BR2_TARGET_TI_K3_IMAGE_GEN_CONFIG
	string "CONFIG type for image gen"
	help
	  The board config option for image gen.
	  Usually "sk" or "evm".
endif
```

## configs/am62x_sk_defconfig
```kconfig
BR2_aarch64=y
BR2_PACKAGE_HOST_LINUX_HEADERS_CUSTOM_5_10=y
BR2_ROOTFS_POST_IMAGE_SCRIPT="support/scripts/genimage.sh"
BR2_ROOTFS_POST_SCRIPT_ARGS="-c board/ti/am62x_sk/genimage.cfg"
BR2_LINUX_KERNEL=y
BR2_LINUX_KERNEL_CUSTOM_TARBALL=y
BR2_LINUX_KERNEL_CUSTOM_TARBALL_LOCATION="https://git.ti.com/cgit/ti-linux-kernel/ti-linux-kernel/snapshot/ti-linux-kernel-08.06.00.007.tar.gz"
BR2_LINUX_KERNEL_USE_CUSTOM_CONFIG=y
BR2_LINUX_KERNEL_CUSTOM_CONFIG_FILE="board/ti/am62x_sk/ti_sdk_arm64_release_defconfig"
BR2_LINUX_KERNEL_DTS_SUPPORT=y
BR2_LINUX_KERNEL_INTREE_DTS_NAME="ti/k3-am625-sk"
BR2_LINUX_KERNEL_INSTALL_TARGET=y
BR2_PACKAGE_LINUX_FIRMWARE=y
BR2_PACKAGE_LINUX_FIRMWARE_TI_WL18XX=y
BR2_TARGET_ROOTFS_EXT2=y
BR2_TARGET_ROOTFS_EXT2_4=y
BR2_TARGET_ROOTFS_EXT2_SIZE="256M"
BR2_TARGET_ARM_TRUSTED_FIRMWARE=y
BR2_TARGET_ARM_TRUSTED_FIRMWARE_CUSTOM_TARBALL=y
BR2_TARGET_ARM_TRUSTED_FIRMWARE_CUSTOM_TARBALL_LOCATION="https://git.trustedfirmware.org/TF-A/trusted-firmware-a.git/snapshot/trusted-firmware-a-2fcd408bb3a6756767a43c073c597cef06e7f2d5.tar.gz"
BR2_TARGET_ARM_TRUSTED_FIRMWARE_PLATFORM="k3"
BR2_TARGET_ARM_TRUSTED_FIRMWARE_TARGET_BOARD="lite"
BR2_TARGET_ARM_TRUSTED_FIRMWARE_BL32_OPTEE=y
BR2_TARGET_OPTEE_OS=y
BR2_TARGET_OPTEE_OS_CUSTOM_TARBALL=y
BR2_TARGET_OPTEE_OS_CUSTOM_TARBALL_LOCATION="https://github.com/OP-TEE/optee_os/archive/8e74d47616a20eaa23ca692f4bbbf917a236ed94.tar.gz"
BR2_TARGET_OPTEE_OS_NEEDS_PYTHON_CRYPTOGRAPHY=y
BR2_TARGET_OPTEE_OS_PLATFORM="k3"
BR2_TARGET_TI_K3_IMAGE_GEN=y
BR2_TARGET_TI_K3_IMAGE_GEN_SOC="am62x"
BR2_TARGET_TI_K3_IMAGE_GEN_SOC_TYPE="gp"
BR2_TARGET_TI_K3_IMAGE_GEN_CONFIG="evm"
BR2_TARGET_TI_K3_R5_LOADER=y
BR2_TARGET_TI_K3_R5_LOADER_CUSTOM_TARBALL=y
BR2_TARGET_TI_K3_R5_LOADER_CUSTOM_TARBALL_LOCATION="https://git.ti.com/cgit/ti-u-boot/ti-u-boot/snapshot/ti-u-boot-08.06.00.007.tar.gz"
BR2_TARGET_TI_K3_R5_LOADER_BOARD_DEFCONFIG="am62x_evm_r5"
BR2_TARGET_UBOOT=y
BR2_TARGET_UBOOT_BUILD_SYSTEM_KCONFIG=y
BR2_TARGET_UBOOT_CUSTOM_TARBALL=y
BR2_TARGET_UBOOT_CUSTOM_TARBALL_LOCATION="https://git.ti.com/cgit/ti-u-boot/ti-u-boot/snapshot/ti-u-boot-08.06.00.007.tar.gz"
BR2_TARGET_UBOOT_BOARD_DEFCONFIG="am62x_evm_a53"
BR2_TARGET_UBOOT_NEEDS_DTC=y
BR2_TARGET_UBOOT_NEEDS_OPENSSL=y
BR2_TARGET_UBOOT_NEEDS_ATF_BL31=y
BR2_TARGET_UBOOT_NEEDS_TI_K3_DM=y
BR2_TARGET_UBOOT_TI_K3_DM_SOC="am62xx"
# BR2_TARGET_UBOOT_FORMAT_BIN is not set
BR2_TARGET_UBOOT_FORMAT_IMG=y
BR2_TARGET_UBOOT_SPL=y
BR2_TARGET_UBOOT_SPL_NAME="tispl.bin"
BR2_TARGET_UBOOT_CUSTOM_MAKEOPTS="TEE=$(BINARIES_DIR)/tee-pager_v2.bin"
BR2_PACKAGE_HOST_DOSFSTOOLS=y
BR2_PACKAGE_HOST_GENIMAGE=y
BR2_PACKAGE_HOST_MTOOLS=y
```

## package/ti-core-secdev-k3/Config.in.host
```kconfig
config BR2_PACKAGE_HOST_TI_CORE_SECDEV_K3
	bool "host ti-core-secdev-k3"
	help
	  ti-core-secdev-k3 is used to provide binary image signing
	  tools and keys to the build process needed to build boot
	  artifacts for the secure boot flow on TI K3 platform
	  "High Security" SoCs (device variants "HS-FS" and "HS-SE").
	  This package is not needed building for "General Purpose"
	  ("GP") SoC variants.

	  https://git.ti.com/cgit/security-development-tools/core-secdev-k3
```
